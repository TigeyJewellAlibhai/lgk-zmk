## boards/shields/lgk/Kconfig.defconfig
```kconfig
# Copyright (c) 2025
# SPDX-License-Identifier: MIT

if SHIELD_LGK

config ZMK_KEYBOARD_NAME
	default "LGK Keyboard"

endif
```

## boards/shields/lgk/Kconfig.shield
```kconfig
# Copyright (c) 2025
# SPDX-License-Identifier: MIT

config SHIELD_LGK
	def_bool $(shields_list_contains,lgk)
```

## config/boards/shields/custom_keyboard/Kconfig.defconfig
```kconfig
# Copyright (c) 2025
# SPDX-License-Identifier: MIT

if SHIELD_CUSTOM_KEYBOARD

config ZMK_KEYBOARD_NAME
	default "Custom Keyboard"

endif
```

## config/boards/shields/custom_keyboard/Kconfig.shield
```kconfig
# Copyright (c) 2025
# SPDX-License-Identifier: MIT

config SHIELD_CUSTOM_KEYBOARD
	def_bool $(shields_list_contains,custom_keyboard)
```

## config/west.yml
```yaml
manifest:manifest:

  defaults:  defaults:

    revision: v0.3    revision: v0.3

  remotes:  remotes:

    - name: zmkfirmware    - name: zmkfirmware

      url-base: https://github.com/zmkfirmware      url-base: https://github.com/zmkfirmware

    # Additional modules containing boards/shields/custom code can be listed here as well    # Additional modules containing boards/shields/custom code can be listed here as well

    # See https://docs.zephyrproject.org/3.2.0/develop/west/manifest.html#projects    # See https://docs.zephyrproject.org/3.2.0/develop/west/manifest.html#projects

  projects:  projects:

    - name: zmk    - name: zmk

      remote: zmkfirmware      remote: zmkfirmware

      import: app/west.yml      import: app/west.yml

  self:  self:

    path: config    path: config
```

## zmk-nice-nano-v2/app/boards/arm/nice_nano_v2/Kconfig.board
```kconfig
# Copyright (c) 2025
# SPDX-License-Identifier: MIT

config BOARD_NICE_NANO_V2
	bool "Nice Nano V2"
	depends on SOC_NRF52840_QIAA
```

## zmk-nice-nano-v2/app/boards/arm/nice_nano_v2/Kconfig.defconfig
```kconfig
# Copyright (c) 2025
# SPDX-License-Identifier: MIT

if BOARD_NICE_NANO_V2

config BOARD
	default "nice_nano_v2"

config ZMK_KEYBOARD_NAME
	default "Nice Nano V2 Custom"

if USB

config USB_NRFX
	default y

config USB_DEVICE_STACK
	default y

endif # USB

config BT_CTLR
	default BT

config ZMK_BLE
	default y

config ZMK_USB
	default y

endif # BOARD_NICE_NANO_V2
```

## zmk-nice-nano-v2/app/boards/arm/nice_nano_v2/nice_nano_v2_defconfig
```kconfig
# Copyright (c) 2025
# SPDX-License-Identifier: MIT

CONFIG_SOC_SERIES_NRF52X=y
CONFIG_SOC_NRF52840_QIAA=y
CONFIG_BOARD_NICE_NANO_V2=y

# Enable MPU
CONFIG_ARM_MPU=y

# Enable hardware stack protection
CONFIG_HW_STACK_PROTECTION=y

# Enable GPIO
CONFIG_GPIO=y

# Enable USB
CONFIG_USB_DEVICE_STACK=y
CONFIG_USB_NRFX=y

# Enable serial port
CONFIG_SERIAL=y
CONFIG_CONSOLE=y
CONFIG_UART_CONSOLE=y
CONFIG_UART_LINE_CTRL=y

# Enable pin controller
CONFIG_PINCTRL=y
```

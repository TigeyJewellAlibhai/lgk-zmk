/*
 * Copyright (c) 2025
 * SPDX-License-Identifier: MIT
 * MINIMAL TEST - Single key
 */

#include <behaviors.dtsi>
#include <dt-bindings/zmk/keys.h>

/ {
    keymap {
        compatible = "zmk,keymap";

        default_layer {
            bindings = <
                &kp A
            >;
        };
    };
};
